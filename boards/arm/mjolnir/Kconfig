## boards/arm/mjolnir/Kconfig
```kconfig
config BOARD_ENABLE_DCDC
    bool "Enable DCDC mode"
    select SOC_DCDC_NRF52X
    default y
    depends on (BOARD_MJOLNIR_LEFT || BOARD_MJOLNIR_RIGHT || BOARD_MJOLNIR_LEFT_FLIP || BOARD_MJOLNIR_RIGHT_FLIP)
```

## boards/arm/mjolnir/Kconfig.board
```kconfig
config BOARD_MJOLNIR_LEFT
    bool "Mjolnir Left"
    depends on SOC_NRF52840_QIAA

config BOARD_MJOLNIR_RIGHT
    bool "Mjolnir Right"
    depends on SOC_NRF52840_QIAA

config BOARD_MJOLNIR_LEFT_FLIP
    bool "Mjolnir Left Flip"
    depends on SOC_NRF52840_QIAA

config BOARD_MJOLNIR_RIGHT_FLIP
    bool "Mjolnir Right Flip"
    depends on SOC_NRF52840_QIAA
```

## boards/arm/mjolnir/Kconfig.defconfig
```kconfig
if BOARD_MJOLNIR_LEFT || BOARD_MJOLNIR_RIGHT_FLIP

config ZMK_KEYBOARD_NAME
    default "Mjolnir"

config ZMK_SPLIT_ROLE_CENTRAL
    default y

endif # BOARD_MJOLNIR_LEFT

if BOARD_MJOLNIR_LEFT || BOARD_MJOLNIR_RIGHT || BOARD_MJOLNIR_RIGHT_FLIP || BOARD_MJOLNIR_LEFT_FLIP

config BOARD
    default "mjolnir"

config ZMK_SPLIT
    default y

config BT_CTLR
    default BT

if USB

config USB_NRFX
    default y

config USB_DEVICE_STACK
    default y
    
endif # USB

config ZMK_MAX17048
	default y 


if ZMK_DISPLAY

config I2C
    default y

endif # ZMK_DISPLAY

endif # BOARD_MJOLNIR_LEFT || BOARD_MJOLNIR_RIGHT || BOARD_MJOLNIR_RIGHT_FLIP || BOARD_MJOLNIR_LEFT_FLIP
```

## boards/arm/mjolnir/mjolnir_rh_defconfig
```kconfig
CONFIG_SOC_SERIES_NRF52X=y
CONFIG_SOC_NRF52840_QIAA=y
CONFIG_BOARD_MJOLNIR_RH=y

# Enable both USB and BLE
CONFIG_ZMK_USB=y
CONFIG_ZMK_BLE=y

# Keyboard IDs
CONFIG_ZMK_KEYBOARD_NAME="Mjolnir Right"
CONFIG_USB_DEVICE_PID=0x27d9
CONFIG_USB_DEVICE_VID=0x16c0
CONFIG_USB_DEVICE_MANUFACTURER="Fuller"
CONFIG_USB_DEVICE_SN="Mjolnir Right"

CONFIG_BT_DIS_PNP_PID=0x27d9
CONFIG_BT_DIS_PNP_VID=0x16c0
CONFIG_BT_DIS_MANUF="Fuller"
CONFIG_BT_DIS_MODEL="Mjolnir Right"

CONFIG_BT_CTLR_TX_PWR_PLUS_8=y

# Enable MPU
CONFIG_ARM_MPU=y

# Enable GPIO
CONFIG_GPIO=y

# Build configurations
CONFIG_BUILD_OUTPUT_UF2=y
CONFIG_BUILD_OUTPUT_UF2_FAMILY_ID="0x9808B007"
CONFIG_USE_DT_CODE_PARTITION=y

# Flash configuration
CONFIG_MPU_ALLOW_FLASH_WRITE=y
CONFIG_NVS=y
CONFIG_SETTINGS_NVS=y
CONFIG_FLASH=y
CONFIG_FLASH_PAGE_LAYOUT=y
CONFIG_FLASH_MAP=y

# Enable 32kHz crystal
CONFIG_CLOCK_CONTROL_NRF_K32SRC_XTAL=y

# The power LED is implemented as a backlight
# For now, the power LED is acting as a "USB connected" indicator
CONFIG_ZMK_BACKLIGHT=y
CONFIG_ZMK_BACKLIGHT_ON_START=y
CONFIG_ZMK_BACKLIGHT_BRT_START=5
CONFIG_ZMK_BACKLIGHT_AUTO_OFF_IDLE=y
CONFIG_ZMK_BACKLIGHT_AUTO_OFF_USB=y

# The full two-byte consumer report space has compatibility issues with some
# operating systems, most notably macOS. Use the more basic single-byte usage
# space.
CONFIG_ZMK_HID_CONSUMER_REPORT_USAGES_BASIC=y

# Turn on debugging to disable optimization. Debug messages can result in larger
# stacks, so enable stack protection and particularly a larger BLE peripheral stack.
# CONFIG_DEBUG=y
# CONFIG_DEBUG_THREAD_INFO=y
# CONFIG_EXCEPTION_STACK_TRACE=y
# CONFIG_HW_STACK_PROTECTION=y
# CONFIG_ZMK_SPLIT_BLE_PERIPHERAL_STACK_SIZE=1300

# Log via USB or Segger RTT
CONFIG_ZMK_USB_LOGGING=n
CONFIG_ZMK_RTT_LOGGING=n
```

## boards/arm/mjolnir/mjolnir_right_flip_defconfig
```kconfig
CONFIG_SOC_SERIES_NRF52X=y
CONFIG_SOC_NRF52840_QIAA=y
CONFIG_BOARD_MJOLNIR_RIGHT_FLIP=y

CONFIG_ZMK_USB=y
CONFIG_ZMK_BLE=y

CONFIG_CLOCK_CONTROL_NRF_K32SRC_RC=y

# Enable deep sleep
CONFIG_ZMK_SLEEP=y

# Enable MPU
CONFIG_ARM_MPU=y

# Enable GPIO
CONFIG_GPIO=y

CONFIG_USE_DT_CODE_PARTITION=y                                                 
CONFIG_BUILD_OUTPUT_UF2=y

CONFIG_MPU_ALLOW_FLASH_WRITE=y
CONFIG_NVS=y
CONFIG_SETTINGS_NVS=y
CONFIG_FLASH=y
CONFIG_FLASH_PAGE_LAYOUT=y
CONFIG_FLASH_MAP=y

# Enable I2C
CONFIG_I2C=y
CONFIG_I2C_NRFX=y

CONFIG_PINCTRL=y

# Add underglow optionas
CONFIG_ZMK_RGB_UNDERGLOW=y
CONFIG_ZMK_RGB_UNDERGLOW_EFF_START=1
CONFIG_WS2812_STRIP=y

# Display
CONFIG_ZMK_DISPLAY_STATUS_SCREEN_BUILT_IN=y
CONFIG_ZMK_LV_FONT_DEFAULT_SMALL_MONTSERRAT_26=y
CONFIG_LV_FONT_DEFAULT_MONTSERRAT_26=y

# Turn on logging, and set ZMK logging to debug output
# CONFIG_LOG=y
# CONFIG_ZMK_USB_LOGGING=y
# CONFIG_ZMK_LOG_LEVEL_DBG=y
# CONFIG_I2C_LOG_LEVEL_DBG=y
# CONFIG_SENSOR_LOG_LEVEL_DBG=y
```

## boards/arm/test-board/Kconfig.defconfig
```kconfig
if BOARD_TEST_BOARD

config ZMK_KEYBOARD_NAME
    default "Test Board"

config BOARD
    default "Test Board"

config BT_CTLR
    default BT

if USB

config USB_NRFX
    default y

config USB_DEVICE_STACK
    default y

endif # USB

endif # BOARD_TEST_BOARD
```
